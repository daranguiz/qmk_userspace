## zmk/config/boards/chocofi.conf
```kconfig
# ZMK Board Configuration: Chocofi
# Board ID: chocofi
# Shield: corne
# Generated: 2025-11-16 14:49:44 UTC

# Basic features
CONFIG_ZMK_KEYBOARD_NAME="Chocofi"
CONFIG_ZMK_SLEEP=y

# Battery reporting (for wireless boards)
CONFIG_ZMK_BATTERY_REPORTING=y

# Bluetooth settings
CONFIG_BT_CTLR_TX_PWR_PLUS_8=y

# Optional features (uncomment as needed)
# CONFIG_ZMK_RGB_UNDERGLOW=y
# CONFIG_ZMK_BACKLIGHT=y
# CONFIG_ZMK_DISPLAY=y
# CONFIG_ZMK_WIDGET_WPM_STATUS=y
# CONFIG_ZMK_WIDGET_BATTERY_STATUS=y

# Add board-specific features below
```

## zmk/config/boards/corne.conf
```kconfig
CONFIG_ZMK_SLEEP=y

# Uncomment to enable USB logging
# CONFIG_ZMK_USB_LOGGING=y
```

## zmk/config/west.yml
```yaml
manifest:
  remotes:
    - name: zmkfirmware
      url-base: https://github.com/zmkfirmware
    - name: urob
      url-base: https://github.com/urob
  projects:
    - name: zmk
      remote: zmkfirmware
      revision: v0.3.0  # pinning because https://zmk.dev/blog/2025/12/09/zephyr-4-1
      import: app/west.yml
    - name: zmk-adaptive-key
      remote: urob
      revision: v0.3.0 
      path: modules/zmk/adaptive-key
  self:
    path: config
```
